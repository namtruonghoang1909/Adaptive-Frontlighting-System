## CMakeLists.txt
```
cmake_minimum_required(VERSION 3.20.0)

find_package(Zephyr REQUIRED HINTS $ENV{ZEPHYR_BASE})
project(afs_ecu)

set(AFS_CAN_GENERATED_DIR ${CMAKE_CURRENT_LIST_DIR}/../../bridge/src/can/generated)

target_include_directories(app PRIVATE
  include
  ${AFS_CAN_GENERATED_DIR}
)

target_sources(app PRIVATE
  src/main.c
  src/application/afs_controller.c
  src/application/afs_ecu_application.c
  src/bsw/ecu_abstraction/can_bus.c
  src/bsw/ecu_abstraction/board_led.c
  src/bsw/services/communication/can_rx_log.c
  src/bsw/services/communication/can_message_service.c
  src/rte/afs_rte.c
  ${AFS_CAN_GENERATED_DIR}/afs.c
)
```

## Kconfig
```
# SPDX-License-Identifier: Apache-2.0

source "Kconfig.zephyr"

config AFS_CAN_RX_LOGGING
	bool "Log received CAN frames for bench testing"
	default n
	help
	  Print each received CAN frame's identifier, DLC, and payload through the
	  configured console. This is high-volume test instrumentation; disable it
	  after bench testing.
```

## west.yml
```
manifest:
  version: "0.13"
  remotes:
    - name: zephyrproject-rtos
      url-base: https://github.com/zephyrproject-rtos
  projects:
    - name: zephyr
      remote: zephyrproject-rtos
      revision: v3.7.0
      import: true
  self:
    path: afs_ecu
```

## prj.conf
```kconfig
CONFIG_GPIO=y
CONFIG_CAN=y
CONFIG_PRINTK=y
CONFIG_USE_SEGGER_RTT=y
CONFIG_RTT_CONSOLE=y
CONFIG_UART_CONSOLE=n
# Temporary high-volume bench instrumentation; disable after CAN testing.
CONFIG_AFS_CAN_RX_LOGGING=y
```

## boards/black_f407ve.overlay
```dts
/* SPDX-License-Identifier: Apache-2.0 */

/* Keep the ECU bus bitrate aligned with bridge and adapter configuration. */
&can2 {
	bitrate = <500000>;
};
```

## src/main.c
```c
/* SPDX-License-Identifier: Apache-2.0 */
#include <afs/application/afs_ecu_application.h>

int main(void)
{
	return afs_ecu_application_run();
}
```
